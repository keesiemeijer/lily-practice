/*
 * Copyright (c) 2022 The ZMK Contributors
 *
 * SPDX-License-Identifier: MIT
 */

// shared between left and right overlay
#include "lily_practice.dtsi"

// Label of the kscan node in the dtsi
&kscan0 {
    col-gpios
        = <&pro_micro 20 GPIO_ACTIVE_HIGH>
        , <&pro_micro 18 GPIO_ACTIVE_HIGH>
        , <&pro_micro 14 GPIO_ACTIVE_HIGH>
        ;
};

&right_encoder {
    status = "okay";
};

&default_transform {
    col-offset = <3>;
};