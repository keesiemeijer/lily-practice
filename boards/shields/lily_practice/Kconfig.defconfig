## boards/shields/lily_practice/Kconfig.defconfig
```kconfig
# Copyright (c) 2022 The ZMK Contributors
# SPDX-License-Identifier: MIT

if SHIELD_LILY_PRACTICE_LEFT

# Name must be less than 16 characters long!
config ZMK_KEYBOARD_NAME
    default "Lily Practice"

config ZMK_SPLIT_ROLE_CENTRAL
    default y

endif

if SHIELD_LILY_PRACTICE_LEFT || SHIELD_LILY_PRACTICE_RIGHT

config ZMK_SPLIT
    default y

endif
```

## boards/shields/lily_practice/Kconfig.shield
```kconfig
# Copyright (c) 2022 The ZMK Contributors
# SPDX-License-Identifier: MIT

# No whitespace after the comma or in your part name!
config SHIELD_LILY_PRACTICE_LEFT
    def_bool $(shields_list_contains,lily_practice_left)

# No whitespace after the comma or in your part name!
config SHIELD_LILY_PRACTICE__RIGHT
    def_bool $(shields_list_contains,lily_practice_right)
```
